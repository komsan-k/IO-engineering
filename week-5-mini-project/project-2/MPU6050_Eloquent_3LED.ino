/*
 MPU6050Simple + EloquentTinyML 3.x + ESP32 + three LEDs
 Based on uploaded train_mpu6050(1).py; use model.h GENERATED by that script.
 Install EloquentTinyML (3.x API) and tflm_esp32 from Arduino Library Manager.
 Do not use the legacy EloquentTinyML 2.x API or mix TFLM runtime libraries.
 MPU6050Simple.h/.cpp are supplied locally in this sketch folder.

 Wiring: MPU6050 SDA=GPIO4, SCL=GPIO5, AD0=GND (0x68), common GND.
 Use 3.3V supply with a compatible breakout and I2C pull-ups to 3.3V.
 GPIO25 -> 330 ohm -> green LED anode, cathode -> GND (stationary=0)
 GPIO26 -> 330 ohm -> yellow LED anode, cathode -> GND (moving=1)
 GPIO27 -> 330 ohm -> red LED anode, cathode -> GND (shaking=2)
 Target pinout: classic ESP32 DevKit/WROOM. Adjust pins for other variants.

 Pipeline: g + deg/s -> header normalization -> header INT8 quantization
           -> EloquentTinyML predict(int8_t*) -> class -> LED.
 Do NOT use predict(float*) with this fully INT8 model.
 Do NOT call predictInt8() on the already quantized buffer.
 No confidence threshold: always display the winning class after debouncing.
 Three consecutive matching predictions stabilize the display (~60ms).
 This is not a window-based classifier; it matches the per-reading model.

 Serial monitor: 115200 baud. Fatal error: all three LEDs blink together.
 model.h is NOT included: run your training script and copy it here.
 Compilation and inference on an actual ESP32 have not been verified here.
 Real-sensor accuracy needs validation; training data were synthetic.
*/

#include <Arduino.h>
#include <Wire.h>
#include <math.h>
#include "MPU6050Simple.h"
#include "model.h"           // Generated header must precede EloquentTinyML
#include <tflm_esp32.h>       // EloquentTinyML's ESP32 runtime
#include <eloquent_tinyml.h> // EloquentTinyML 3.x (lowercase header)

constexpr int kSda = 4;
constexpr int kScl = 5;
constexpr int kLedPins[3] = {25, 26, 27};
constexpr uint32_t kSamplePeriodMs = 20;  // nominal 50Hz
constexpr uint8_t kStablePredictions = 3; // set to 1 for immediate display
constexpr uint32_t kArenaBytes = 24 * 1024;

MPU6050Simple mpu;
// Unique operations: FullyConnected (with fused ReLU) and Softmax.
Eloquent::TF::Sequential<2, kArenaBytes> tf;

int displayedClass = -1;
int candidateClass = -1;
uint8_t candidateCount = 0;
uint32_t lastSampleMs = 0;
uint32_t lastPrintMs = 0;

void displayClass(int label) {
  for (int pin : kLedPins) digitalWrite(pin, LOW);
  if (label >= 0 && label < 3) digitalWrite(kLedPins[label], HIGH);
}

void fatalError(const char* message) {
  Serial.print("ERROR: "); Serial.println(message);
  while (true) {
    for (int pin : kLedPins) digitalWrite(pin, HIGH);
    delay(200);
    for (int pin : kLedPins) digitalWrite(pin, LOW);
    delay(200);
  }
}

// Check the actual model contract, not just the byte-array's variable name.
void checkModelContract() {
  const tflite::Model* model = tflite::GetModel(model_data);
  if (model->version() != TFLITE_SCHEMA_VERSION)
    fatalError("Model schema does not match tflm_esp32.");
  const auto* graphs = model->subgraphs();
  if (!graphs || graphs->size() != 1) fatalError("Expected one model subgraph.");
  const auto* graph = graphs->Get(0);
  if (!graph->inputs() || !graph->outputs() ||
      graph->inputs()->size() != 1 || graph->outputs()->size() != 1)
    fatalError("Expected one input tensor and one output tensor.");
  const auto* input = graph->tensors()->Get(graph->inputs()->Get(0));
  const auto* output = graph->tensors()->Get(graph->outputs()->Get(0));
  if (input->type() != tflite::TensorType_INT8 ||
      output->type() != tflite::TensorType_INT8 ||
      !input->shape() || input->shape()->size() != 2 ||
      input->shape()->Get(0) != 1 || input->shape()->Get(1) != 6 ||
      !output->shape() || output->shape()->size() != 2 ||
      output->shape()->Get(0) != 1 || output->shape()->Get(1) != 3)
    fatalError("Expected INT8 input [1,6] and INT8 output [1,3].");
  const auto* q = input->quantization();
  if (!q || !q->scale() || !q->zero_point() ||
      q->scale()->size() != 1 || q->zero_point()->size() != 1 ||
      !isfinite(mpu6050_input_scale) || mpu6050_input_scale <= 0 ||
      fabsf(q->scale()->Get(0) - mpu6050_input_scale) > 1e-7f ||
      q->zero_point()->Get(0) != mpu6050_input_zero_point)
    fatalError("Input quantization constants do not match model.h.");
  for (int i = 0; i < 6; ++i) {
    if (!isfinite(mpu6050_mean[i]) || !isfinite(mpu6050_std[i]) ||
        mpu6050_std[i] <= 0) fatalError("Invalid normalization constants.");
  }
}

void updateLed(int predictedClass) {
  if (predictedClass != candidateClass) {
    candidateClass = predictedClass;
    candidateCount = 1;
  } else if (candidateCount < kStablePredictions) {
    ++candidateCount;
  }
  if (candidateCount >= kStablePredictions && displayedClass != candidateClass) {
    displayedClass = candidateClass;
    displayClass(displayedClass);
  }
}

void setup() {
  Serial.begin(115200);
  for (int pin : kLedPins) { pinMode(pin, OUTPUT); digitalWrite(pin, LOW); }
  delay(500);
  Serial.println("MPU6050Simple + EloquentTinyML: stationary / moving / shaking");
  Wire.begin(kSda, kScl);
  Wire.setClock(100000);
  Wire.setTimeOut(50);
  if (!mpu.begin(Wire, 0x68,
                 MPU6050Simple::AccelRange::G4,
                 MPU6050Simple::GyroRange::DPS500))
    fatalError(mpu.errorMessage());
  checkModelContract();
  tf.setNumInputs(6);
  tf.setNumOutputs(3);
  if (tf.resolver.AddFullyConnected() != kTfLiteOk ||
      tf.resolver.AddSoftmax() != kTfLiteOk)
    fatalError("Cannot register the model's operations.");
  if (!tf.begin(model_data).isOk()) {
    Serial.println(tf.exception.toString());
    fatalError("Model initialization failed. Check operator support and arena.");
  }
  Serial.println("Ready: green=stationary, yellow=moving, red=shaking");
  Serial.printf("Model bytes=%u, arena reserved=%lu\n", model_data_len,
                static_cast<unsigned long>(kArenaBytes));
  lastSampleMs = millis();
}

void loop() {
  const uint32_t now = millis();
  if (static_cast<uint32_t>(now - lastSampleMs) < kSamplePeriodMs) {
    delay(1);
    return;
  }
  lastSampleMs = now; // no catch-up burst of repeated readings after a delay
  float features[6];
  if (!mpu.readFeatures(features)) fatalError(mpu.errorMessage());
  int8_t quantized[6];
  // Uses mean/std and quantization from the SAME generated model.h.
  mpu6050_prepare_input(features, quantized);
  const uint32_t startUs = micros();
  if (!tf.predict(quantized).isOk()) {
    Serial.println(tf.exception.toString());
    fatalError("INT8 inference failed.");
  }
  const uint32_t inferenceUs = micros() - startUs;
  const int prediction = static_cast<int>(tf.classification);
  if (prediction < 0 || prediction >= 3) fatalError("Invalid predicted class.");
  updateLed(prediction);
  if (static_cast<uint32_t>(now - lastPrintMs) >= 200) {
    lastPrintMs = now;
    Serial.printf("Prediction=%s LED=%s inference=%lu us acc_g=[%.3f %.3f %.3f] gyro_dps=[%.2f %.2f %.2f]\n",
      mpu6050_labels[prediction],
      displayedClass >= 0 ? mpu6050_labels[displayedClass] : "waiting",
      static_cast<unsigned long>(inferenceUs),
      features[0], features[1], features[2], features[3], features[4], features[5]);
    if (inferenceUs >= kSamplePeriodMs * 1000UL)
      Serial.println("Timing warning: inference alone exceeds the 20ms target.");
  }
}
