/*
 Gesture-controlled light: MPU6050Simple + EloquentTinyML 3.x + ESP32.
 Matches model.h generated by train_mpu6050_gestures.py:
 24 features -> Dense32/ReLU -> Dense16/ReLU -> 5 Softmax outputs, INT8.

 REQUIRED FILES in this folder:
   Gesture_Controlled_Light.ino, MPU6050Simple.h/.cpp, MotionFeatures.h,
   LightControl.h, and your GENERATED model.h (not included).
 REQUIRED LIBRARIES: EloquentTinyML 3.x, tflm_esp32.
 Do not substitute the earlier six-input/three-class model.h.

 Classic ESP32 DevKit/WROOM wiring:
   MPU6050 SDA=GPIO4, SCL=GPIO5, AD0=GND (0x68), GND=GND.
   Supply 3.3V using a compatible breakout; I2C pull-ups must go to 3.3V.
   GPIO25 -> 330-ohm resistor -> LED anode; LED cathode -> GND.
   This sketch drives a small demonstration LED, not a mains lamp.

 Classes: 0=tilt_left/OFF; 1=tilt_right/ON; 2=up/BRIGHTER;
          3=down/DIMMER; 4=idle/KEEP_STATE.
 At startup, hold still for one FULL idle window to arm the controller.
 After each action, return to idle for one full window before another action.
 Non-overlapping 50-reading windows, nominally 50Hz (about 1s per inference).
 Serial Monitor: 115200 baud. Fatal error switches LED OFF and halts.
 There is no confidence threshold; use only after real-data evaluation.

 PWM API selection handles Arduino ESP32 core 2.x and 3.x. This does not
 guarantee the separately installed TinyML runtime supports both cores.
 The package is source-complete but still requires your generated model.
 Hardware compilation, model kernels, timing and accuracy need validation.
*/

#include <Arduino.h>
#include <Wire.h>
#include <math.h>
#include <esp_arduino_version.h>
#include "MPU6050Simple.h"
#include "MotionFeatures.h"
#include "LightControl.h"
#include "model.h" // include before EloquentTinyML
#include <tflm_esp32.h>
#include <eloquent_tinyml.h>

constexpr int kSda = 4;
constexpr int kScl = 5;
constexpr int kLightPin = 25;
constexpr uint8_t kAddress = 0x68;
constexpr uint32_t kPeriodUs = 20000;
constexpr uint32_t kMaxGapUs = 30000;
constexpr uint32_t kPwmFrequency = 5000;
constexpr uint8_t kPwmResolution = 8;
constexpr uint8_t kPwmChannel = 0; // ESP32 core 2.x only
constexpr uint32_t kArenaBytes = 24 * 1024;

MPU6050Simple mpu;
LightControl light;
Eloquent::TF::Sequential<2, kArenaBytes> tf;
float windowData[kWindowSize][kAxes];
float featureData[kFeatureCount];
int sampleCount = 0;
uint32_t lastSampleUs = 0;
bool pwmReady = false;

bool writeBrightness(int value) {
#if ESP_ARDUINO_VERSION_MAJOR >= 3
  return ledcWrite(kLightPin, static_cast<uint32_t>(value));
#else
  ledcWrite(kPwmChannel, static_cast<uint32_t>(value));
  return true; // legacy API does not return status
#endif
}

void fatalError(const char* message) {
  if (pwmReady) writeBrightness(0);
  else { pinMode(kLightPin, OUTPUT); digitalWrite(kLightPin, LOW); }
  Serial.print("FATAL: "); Serial.println(message);
  while (true) delay(1000);
}

void initializePwm() {
  pinMode(kLightPin, OUTPUT);
  digitalWrite(kLightPin, LOW);
#if ESP_ARDUINO_VERSION_MAJOR >= 3
  if (!ledcAttach(kLightPin, kPwmFrequency, kPwmResolution))
    fatalError("PWM attachment failed.");
#else
  if (ledcSetup(kPwmChannel, kPwmFrequency, kPwmResolution) <= 0)
    fatalError("PWM setup failed.");
  ledcAttachPin(kLightPin, kPwmChannel);
#endif
  pwmReady = true;
  if (!writeBrightness(0)) fatalError("PWM write failed.");
}

void checkModel() {
  if (GESTURE_NUM_INPUTS != 24 || GESTURE_NUM_CLASSES != 5)
    fatalError("Expected the NEW 24-input five-class gesture header.");
  const tflite::Model* model = tflite::GetModel(model_data);
  if (model->version() != TFLITE_SCHEMA_VERSION)
    fatalError("TensorFlow schema mismatch.");
  const auto* graphs = model->subgraphs();
  if (!graphs || graphs->size() != 1) fatalError("Expected one subgraph.");
  const auto* graph = graphs->Get(0);
  if (!graph->inputs() || graph->inputs()->size() != 1 ||
      !graph->outputs() || graph->outputs()->size() != 1)
    fatalError("Expected one input and one output.");
  const auto* input = graph->tensors()->Get(graph->inputs()->Get(0));
  const auto* output = graph->tensors()->Get(graph->outputs()->Get(0));
  if (input->type() != tflite::TensorType_INT8 || output->type() != tflite::TensorType_INT8 ||
      !input->shape() || input->shape()->size() != 2 ||
      input->shape()->Get(0) != 1 || input->shape()->Get(1) != 24 ||
      !output->shape() || output->shape()->size() != 2 ||
      output->shape()->Get(0) != 1 || output->shape()->Get(1) != 5)
    fatalError("Expected INT8 tensors [1,24] and [1,5].");
  const auto* quant = input->quantization();
  if (!quant || !quant->scale() || !quant->zero_point() ||
      quant->scale()->size() != 1 || quant->zero_point()->size() != 1 ||
      !isfinite(gesture_input_scale) || gesture_input_scale <= 0 ||
      fabsf(quant->scale()->Get(0) - gesture_input_scale) > 1e-7f ||
      quant->zero_point()->Get(0) != gesture_input_zero_point)
    fatalError("Input quantization constants differ from model.");
  for (int i = 0; i < kFeatureCount; ++i)
    if (!isfinite(gesture_mean[i]) || !isfinite(gesture_std[i]) || gesture_std[i] <= 0)
      fatalError("Invalid feature normalization constants.");
}

void setup() {
  Serial.begin(115200);
  initializePwm();
  delay(1000);
  Serial.println("Gesture-controlled light: 24 features / 5 classes");
  Wire.begin(kSda, kScl);
  Wire.setClock(100000);
  Wire.setTimeOut(50);
  if (!mpu.begin(Wire, kAddress,
                 MPU6050Simple::AccelRange::G4,
                 MPU6050Simple::GyroRange::DPS500)) fatalError(mpu.errorMessage());
  checkModel();
  tf.setNumInputs(24);
  tf.setNumOutputs(5);
  if (tf.resolver.AddFullyConnected() != kTfLiteOk || tf.resolver.AddSoftmax() != kTfLiteOk)
    fatalError("Operator registration failed.");
  if (!tf.begin(model_data).isOk()) {
    Serial.println(tf.exception.toString());
    fatalError("Model initialization failed; inspect runtime/kernel/arena diagnostics.");
  }
  Serial.printf("Model=%u bytes, reserved arena=%lu bytes\n", model_data_len,
                static_cast<unsigned long>(kArenaBytes));
  Serial.println("Hold idle for a complete window to arm. Light starts OFF.");
  lastSampleUs = micros();
}

void classifyWindow() {
  extractFeatures(windowData, featureData);
  for (int i = 0; i < kFeatureCount; ++i)
    if (!isfinite(featureData[i])) fatalError("Nonfinite extracted feature.");
  int8_t quantized[kFeatureCount];
  gesture_prepare_input(featureData, quantized); // normalize and quantize ONCE
  const uint32_t startUs = micros();
  if (!tf.predict(quantized).isOk()) {
    Serial.println(tf.exception.toString());
    fatalError("INT8 prediction failed.");
  }
  const uint32_t inferenceUs = micros() - startUs;
  const int label = static_cast<int>(tf.classification);
  if (label < 0 || label >= 5) fatalError("Invalid class index.");
  const bool accepted = light.accept(label);
  if (accepted && !writeBrightness(light.brightness)) fatalError("PWM write failed.");
  Serial.printf("Gesture=%s action=%s status=%s PWM=%d/255 inference=%lu us\n",
    gesture_labels[label], gesture_actions[label],
    label == 4 ? "ARMED" : accepted ? "EXECUTED" : "WAIT_FOR_IDLE",
    light.brightness, static_cast<unsigned long>(inferenceUs));
}

void loop() {
  const uint32_t nowUs = micros();
  const uint32_t elapsed = nowUs - lastSampleUs;
  if (elapsed < kPeriodUs) { delay(1); return; }
  if (elapsed > kMaxGapUs) {
    if (sampleCount > 0) {
      sampleCount = 0;
      light.disarm();
      Serial.println("Sampling gap: partial window discarded; return to idle.");
    }
    // A delay BETWEEN complete windows is harmless to feature timing.
  }
  lastSampleUs = nowUs; // no catch-up burst
  float reading[kAxes];
  if (!mpu.readFeatures(reading)) fatalError(mpu.errorMessage());
  for (int axis = 0; axis < kAxes; ++axis) {
    if (!isfinite(reading[axis])) fatalError("Invalid sensor reading.");
    windowData[sampleCount][axis] = reading[axis];
  }
  ++sampleCount;
  if (sampleCount == kWindowSize) {
    sampleCount = 0;
    classifyWindow();
    // Restart sampling clock after processing to avoid carrying inference
    // duration into the next window or pretending continuous acquisition.
    lastSampleUs = micros();
  }
}
